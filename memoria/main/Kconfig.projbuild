## memoria/main/Kconfig.projbuild
```kconfig
menu "Menu Personalizado"

  config NOME_DO_PROJETO
    string "Nome do projeto"
    default "Projeto de Demonstração - FSE"
    help
      Preencha o nome do projeto

  config AMBIENTE
    choice
      bool "Selecione uma opção"
        default DEBUG
      config DEBUG
       bool "Habilitar o modo DEBUG"
     config HOMOLOGACAO 
       bool "Habilitar o modo HOMOLOGACAO"
     config PRODUCAO
       bool "Habilitar o modo PRODUCAO"
  endchoice

  config FREQUENCIA_DE_ATUALIZACAO
    int "10"
    range 1 30
endmenu
```

## rede/wifi2/main/Kconfig.projbuild
```kconfig
menu "Configuração do Wifi Configuration"

  config WIFI_SSID
    string "Wifi SSID"
    default "ssid"
    help
      Nome da rede Wifi.

  config WIFI_PASSWORD
    string "Senha do wifi"
    default "minha_senha"
    help
      Senha do Wifi (WPA or WPA2).

  config MAXIMUM_RETRY
    int "Número máximo de tentativas de conexão"
    default 5
    help
      Configure o valor máximo de tentativas de conexão.
endmenu
```
